## boards/shields/la_replique/Kconfig.defconfig
```kconfig
# Copyright (c) 2022 The ZMK Contributors
# SPDX-License-Identifier: MIT

if SHIELD_LA_REPLIQUE

config ZMK_KEYBOARD_NAME
    default "la replique"

endif
```

## boards/shields/la_replique/Kconfig.shield
```kconfig
# Copyright (c) 2022 The ZMK Contributors
# SPDX-License-Identifier: MIT

config SHIELD_LA_REPLIQUE
    def_bool $(shields_list_contains,la_replique)
```
